/* Native RGB->DP3364S encoder. Timing template is generated by verified Python. */
#include <stdint.h>
#include <stddef.h>
#include <string.h>

#define FRAME_BYTES (1288u * 182u * 4u)
#define FULL_FRAME_BYTES (1288u * 514u * 4u)

int panel_encode_v2(const uint8_t *rgb, size_t rgb_size, const uint8_t *timing,
                 size_t timing_size, uint8_t *output, size_t output_size,
                 unsigned brightness, unsigned max_level) {
    if (!rgb || !timing || !output || rgb_size != 160u*80u*3u ||
        (timing_size != FRAME_BYTES && timing_size != FULL_FRAME_BYTES) ||
        output_size != timing_size || brightness > 100 || max_level > 65535)
        return -1;
    memcpy(output, timing, timing_size);
    uint32_t *pixels = (uint32_t *)output;
    /* Logical RGB -> physical B/G/R, both halves; DPI D0 == GPIO4. */
    static const uint32_t masks[2][3] = {
        {1u<<3, 1u<<23, 1u<<7}, {1u<<6, 1u<<5, 1u<<4}
    };
    unsigned codes[256];
    for (unsigned i=0; i<256; ++i)
        codes[i] = i*max_level*brightness/(255u*100u);
    for (unsigned y=1; y<79; ++y) {
        const unsigned base = 644u + (y%40u)*16u*161u;
        for (unsigned x=1; x<160; ++x) {
            const unsigned word = base + (x%16u)*161u + (x/16u)*16u;
            for (unsigned c=0; c<3; ++c) {
                unsigned code = codes[rgb[(y*160u+x)*3u+c]];
                while (code) {
                    unsigned bit = (unsigned)__builtin_ctz(code);
                    const unsigned p = (word+15u-bit)*2u;
                    pixels[p] |= masks[y/40u][c];
                    pixels[p+1] |= masks[y/40u][c];
                    code &= code-1u;
                }
            }
        }
    }
    return 0;
}
